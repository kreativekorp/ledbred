#include <Arduino.h>
#include <Adafruit_GFX.h>
#include <Adafruit_SSD1306.h>
#include "config.h"
#include "display.h"

static Adafruit_SSD1306 display(
  SCREEN_WIDTH, SCREEN_HEIGHT,
  OLED_MOSI, OLED_CLK,
  OLED_DC, OLED_RESET, OLED_CS
);

void displayBegin() {
  display.begin(SSD1306_SWITCHCAPVCC);
  display.clearDisplay();
  display.display();
}

void displayClear() {
  display.clearDisplay();
}

void displayUpdate() {
  display.display();
}

static const unsigned char PROGMEM font_bmp[] = {
  0x00, 0x00, 0x00, 0x00, 0x00, 0x00, 0x00, 0x00, 0x00, 0x00, 0x00, 0x00,
  0x00, 0x18, 0x18, 0x18, 0x18, 0x18, 0x18, 0x00, 0x18, 0x18, 0x00, 0x00,
  0x00, 0x66, 0x66, 0x66, 0x66, 0x00, 0x00, 0x00, 0x00, 0x00, 0x00, 0x00,
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  0x66, 0x66, 0x00, 0x66, 0x66, 0x66, 0x66, 0x66, 0x6E, 0x36, 0x06, 0x3C,
};

void displayString(const char * str, int x, int y, int fg, int bg) {
  unsigned char ch;
  unsigned int idx;
  while ((ch = *str)) {
    if (ch > 32) {
      idx = ch;
      idx -= 32;
      idx *= 12;
      display.drawBitmap(x, y, &font_bmp[idx], 8, 12, fg, bg);
    }
    x += 8;
    str++;
  }
}

void displayStringCenter(const char * str, int x, int y, int fg, int bg) {
  displayString(str, x-strlen(str)*4, y, fg, bg);
}

void displayStringRight(const char * str, int x, int y, int fg, int bg) {
  displayString(str, x-strlen(str)*8, y, fg, bg);
}

static const unsigned char PROGMEM icon_bmp[] = {
  /* Color */
  0x03, 0x80, 0x07, 0xC0, 0x0F, 0xE0, 0x1F, 0xF0, 0x3F, 0xF8, 0x3F, 0xF8, 0x3F, 0xF8, 0x3F, 0xF8, 0xFF, 0xFE, 0xFF, 0xFE, 0xFF, 0xFE, 0xFF, 0xFE, 0xFF, 0xFE, 0xFF, 0xFE, 0xFF, 0xFE, 0xFF, 0xFE,
  0x03, 0x80, 0x07, 0xC0, 0x0E, 0xE0, 0x1D, 0x70, 0x3A, 0xB8, 0x35, 0x58, 0x3A, 0xB8, 0x35, 0x58, 0xFF, 0xFE, 0xFF, 0xFE, 0xD5, 0x56, 0xEA, 0xAE, 0xD5, 0x56, 0xEA, 0xAE, 0xD5, 0x56, 0xEA, 0xAE,
  0x03, 0x80, 0x07, 0xC0, 0x0E, 0xE0, 0x1D, 0x70, 0x38, 0x38, 0x35, 0x58, 0x30, 0x18, 0x35, 0x58, 0xFF, 0xFE, 0xFF, 0xFE, 0xC0, 0x06, 0xD5, 0x56, 0xC0, 0x06, 0xD5, 0x56, 0xC0, 0x06, 0xD5, 0x56,
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  0x03, 0x80, 0x07, 0xC0, 0x0E, 0xE0, 0x1D, 0x70, 0x3C, 0xF8, 0x36, 0x58, 0x3D, 0x78, 0x34, 0xD8, 0xFF, 0xFE, 0xFF, 0xFE, 0xC9, 0x26, 0xED, 0xB6, 0xDB, 0x6E, 0xC9, 0x26, 0xED, 0xB6, 0xDB, 0x6E,
  /* Brightness */
  /* 16 = Lo */ 0x00, 0x00, 0x00, 0x00, 0x01, 0x80, 0x09, 0x90, 0x1C, 0x38, 0x09, 0x90, 0x03, 0xC0, 0x36, 0x6C, 0x36, 0x6C, 0x03, 0xC0, 0x09, 0x90, 0x1C, 0x38, 0x09, 0x90, 0x01, 0x80, 0x00, 0x00, 0x00, 0x00,
  /* 17 = Hi */ 0x01, 0x80, 0x01, 0x80, 0x11, 0x88, 0x39, 0x9C, 0x1C, 0x38, 0x09, 0x90, 0x03, 0xC0, 0xF6, 0x6F, 0xF6, 0x6F, 0x03, 0xC0, 0x09, 0x90, 0x1C, 0x38, 0x39, 0x9C, 0x11, 0x88, 0x01, 0x80, 0x01, 0x80,
  /* Confirmation */
  /* 18 = OK */ 0x07, 0xE0, 0x1F, 0xF8, 0x3C, 0x3C, 0x70, 0x0E, 0x60, 0x06, 0xE0, 0x07, 0xC0, 0x03, 0xC0, 0x03, 0xC0, 0x03, 0xC0, 0x03, 0xE0, 0x07, 0x60, 0x06, 0x70, 0x0E, 0x3C, 0x3C, 0x1F, 0xF8, 0x07, 0xE0,
  /* 19 = NG */ 0xC0, 0x03, 0xE0, 0x07, 0x70, 0x0E, 0x38, 0x1C, 0x1C, 0x38, 0x0E, 0x70, 0x07, 0xE0, 0x03, 0xC0, 0x03, 0xC0, 0x07, 0xE0, 0x0E, 0x70, 0x1C, 0x38, 0x38, 0x1C, 0x70, 0x0E, 0xE0, 0x07, 0xC0, 0x03,
  /* Other Stuff */
  /* 20 = file */ 0x7F, 0xE0, 0x7F, 0xF0, 0x60, 0x78, 0x60, 0x6C, 0x60, 0x7E, 0x60, 0x7E, 0x60, 0x06, 0x60, 0x06, 0x60, 0x06, 0x60, 0x06, 0x60, 0x06, 0x60, 0x06, 0x60, 0x06, 0x60, 0x06, 0x7F, 0xFE, 0x7F, 0xFE,
  /* 21 = open */ 0x79, 0x9E, 0x73, 0xCE, 0x67, 0xE6, 0x61, 0x86, 0x61, 0x86, 0x61, 0x86, 0x61, 0x86, 0x60, 0x06, 0x60, 0x36, 0x6D, 0xB6, 0x6D, 0xB6, 0x6D, 0xB6, 0x6D, 0x8E, 0x60, 0x1C, 0x7F, 0xF8, 0x7F, 0xF0,
  /* 22 = save */ 0x7D, 0xBE, 0x7D, 0xBE, 0x61, 0x86, 0x61, 0x86, 0x67, 0xE6, 0x63, 0xC6, 0x61, 0x86, 0x60, 0x06, 0x60, 0x36, 0x6D, 0xB6, 0x6D, 0xB6, 0x6D, 0xB6, 0x6D, 0x8E, 0x60, 0x1C, 0x7F, 0xF8, 0x7F, 0xF0,
  /* 23 = nosd */ 0x73, 0xCE, 0x76, 0x6E, 0x60, 0x66, 0x60, 0xC6, 0x61, 0x86, 0x60, 0x06, 0x61, 0x86, 0x60, 0x06, 0x60, 0x36, 0x6D, 0xB6, 0x6D, 0xB6, 0x6D, 0xB6, 0x6D, 0x8E, 0x60, 0x1C, 0x7F, 0xF8, 0x7F, 0xF0,
  /* 24 = color */ 0x00, 0x00, 0x03, 0x80, 0x05, 0x40, 0x0A, 0xA0, 0x0D, 0x60, 0x0A, 0xA0, 0x05, 0x40, 0x03, 0x80, 0x38, 0x38, 0x44, 0x7C, 0x82, 0xFE, 0x82, 0xFE, 0x82, 0xFE, 0x44, 0x7C, 0x38, 0x38, 0x00, 0x00,
  /* 25 = clear */ 0x00, 0x00, 0x00, 0xFF, 0x01, 0xFF, 0x03, 0x8F, 0x07, 0x1F, 0x0E, 0x3B, 0x1C, 0x77, 0x38, 0xEE, 0x71, 0xDC, 0xFF, 0xB8, 0xFF, 0x70, 0xC3, 0xE0, 0xC3, 0xC0, 0xFF, 0x80, 0xFF, 0x00, 0x00, 0x00,
  /* 26 = exit */ 0xFF, 0xFF, 0xFF, 0xFF, 0xC0, 0x03, 0xC0, 0xE3, 0xC0, 0xE3, 0xC0, 0x03, 0xC7, 0xE3, 0xCF, 0xF3, 0xDD, 0xFF, 0xDB, 0xDF, 0xC7, 0x83, 0xC7, 0x83, 0xBE, 0xC3, 0xBC, 0xC3, 0xC0, 0x63, 0xC0, 0x63,
};

void displayIcon(int i, int x, int y, int fg, int bg) {
  display.drawBitmap(x, y, &icon_bmp[i*32], 16, 16, fg, bg);
}

static const char color_name_0[] PROGMEM = "Black";
static const char color_name_1[] PROGMEM = "Dark Gray";
static const char color_name_2[] PROGMEM = "Light Gray";
static const char color_name_3[] PROGMEM = "White";
static const char color_name_4[] PROGMEM = "Yellow";
static const char color_name_5[] PROGMEM = "Orange";
static const char color_name_6[] PROGMEM = "Red";
static const char color_name_7[] PROGMEM = "Pink";
static const char color_name_8[] PROGMEM = "Purple";
static const char color_name_9[] PROGMEM = "Blue";
static const char color_name_A[] PROGMEM = "Turquoise";
static const char color_name_B[] PROGMEM = "Aquamarine";
static const char color_name_C[] PROGMEM = "Bright Green";
static const char color_name_D[] PROGMEM = "Dark Green";
static const char color_name_E[] PROGMEM = "Tan";
static const char color_name_F[] PROGMEM = "Brown";
static const char * const color_name[] PROGMEM = {
  color_name_0, color_name_1, color_name_2, color_name_3,
  color_name_4, color_name_5, color_name_6, color_name_7,
  color_name_8, color_name_9, color_name_A, color_name_B,
  color_name_C, color_name_D, color_name_E, color_name_F,
};

void displayColorSelect(int i) {
  char str[16];
  display.clearDisplay();
  display.fillRect(SCREEN_WIDTH/2-10, 0, 20, 18, 1);
  display.drawBitmap(SCREEN_WIDTH/2-8, 1, &icon_bmp[i*32], 16, 16, 0, 1);
  for (int x = SCREEN_WIDTH/2-28, j = i-1; x > -16; j--, x -= 20) {
    display.drawBitmap(x, 1, &icon_bmp[(j&15)*32], 16, 16, 1, 0);
  }
  for (int x = SCREEN_WIDTH/2+12, j = i+1; x < SCREEN_WIDTH; j++, x += 20) {
    display.drawBitmap(x, 1, &icon_bmp[(j&15)*32], 16, 16, 1, 0);
  }
  strcpy_P(str, (char *)pgm_read_word(&color_name[i]));
  displayStringCenter(str, SCREEN_WIDTH/2, 20, 1, 0);
  display.display();
}

void displayLevelSelect(int i) {
  char str[4];
  display.clearDisplay();
  display.drawBitmap(0, 1, &icon_bmp[16*32], 16, 16, 1, 0);
  display.drawBitmap(SCREEN_WIDTH-16, 1, &icon_bmp[17*32], 16, 16, 1, 0);
  display.drawRect(20, 3, SCREEN_WIDTH-40, 12, 1);
  display.fillRect(20, 3, (SCREEN_WIDTH-40)*i/15, 12, 1);
  displayString("Brightness", 0, 20, 1, 0);
  if (i < 10) { str[0] = '0' + i; str[1] = 0; }
  else { str[0] = '0' + i/10; str[1] = '0' + i%10; str[2] = 0; }
  displayStringRight(str, SCREEN_WIDTH, 20, 1, 0);
  display.display();
}

void displayMessage(int icon, const char * str) {
  display.clearDisplay();
  display.drawBitmap(SCREEN_WIDTH/2-8, 1, &icon_bmp[icon*32], 16, 16, 1, 0);
  displayStringCenter(str, SCREEN_WIDTH/2, 20, 1, 0);
  display.display();
}

void displayConfirmation(const char * str, int i) {
  display.clearDisplay();
  displayStringCenter(str, SCREEN_WIDTH/2, 0, 1, 0);
  display.fillRect(0, 14, SCREEN_WIDTH/2, 18, !!i);
  display.fillRect(SCREEN_WIDTH/2, 14, SCREEN_WIDTH/2, 18, !i);
  display.drawBitmap(2, 15, &icon_bmp[18*32], 16, 16, !i, !!i);
  display.drawBitmap(SCREEN_WIDTH/2 + 2, 15, &icon_bmp[19*32], 16, 16, !!i, !i);
  displayString("Yes", 20, 17, !i, !!i);
  displayString("No", SCREEN_WIDTH/2 + 20, 17, !!i, !i);
  display.display();
}

void displayMenuSelect(int n, const int * icons, const char ** items, int i) {
  char str[16];
  int icon = pgm_read_word(&icons[i]);
  display.clearDisplay();
  display.fillRect(SCREEN_WIDTH/2-10, 0, 20, 18, 1);
  display.drawBitmap(SCREEN_WIDTH/2-8, 1, &icon_bmp[icon*32], 16, 16, 0, 1);
  for (int x = SCREEN_WIDTH/2-28, j = i-1; x > -16; j--, x -= 20) {
    if (j < 0) j += n;
    icon = pgm_read_word(&icons[j]);
    display.drawBitmap(x, 1, &icon_bmp[icon*32], 16, 16, 1, 0);
  }
  for (int x = SCREEN_WIDTH/2+12, j = i+1; x < SCREEN_WIDTH; j++, x += 20) {
    if (j >= n) j -= n;
    icon = pgm_read_word(&icons[j]);
    display.drawBitmap(x, 1, &icon_bmp[icon*32], 16, 16, 1, 0);
  }
  strcpy_P(str, (char *)pgm_read_word(&items[i]));
  displayStringCenter(str, SCREEN_WIDTH/2, 20, 1, 0);
  display.display();
}

void displayFileSelect(int i, int n, const char * name) {
  int icon = ((i < 0 || i >= n) ? 26 : 20);
  display.clearDisplay();
  display.fillRect(SCREEN_WIDTH/2-10, 0, 20, 18, 1);
  display.drawBitmap(SCREEN_WIDTH/2-8, 1, &icon_bmp[icon*32], 16, 16, 0, 1);
  for (int x = SCREEN_WIDTH/2-28, j = i-1; x > -16; j--, x -= 20) {
    if (j < 0) j += (n+1);
    icon = ((j < 0 || j >= n) ? 26 : 20);
    display.drawBitmap(x, 1, &icon_bmp[icon*32], 16, 16, 1, 0);
  }
  for (int x = SCREEN_WIDTH/2+12, j = i+1; x < SCREEN_WIDTH; j++, x += 20) {
    if (j > n) j -= (n+1);
    icon = ((j < 0 || j >= n) ? 26 : 20);
    display.drawBitmap(x, 1, &icon_bmp[icon*32], 16, 16, 1, 0);
  }
  displayStringCenter(name, SCREEN_WIDTH/2, 20, 1, 0);
  display.display();
}
